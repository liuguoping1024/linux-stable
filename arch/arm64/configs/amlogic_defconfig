## arch/arm64/configs/amlogic_defconfig
```kconfig
# Amlogic ARM64 defconfig for linux-stable 6.6.18 (android15-6.6)
# Minimal config for Amlogic Meson platforms with custom drivers
# Based on 5.10.247 amlogic config

#
# Platform
#
CONFIG_ARM64=y
CONFIG_ARCH_MESON=y
CONFIG_SMP=y
CONFIG_NR_CPUS=8
CONFIG_PREEMPT=y
CONFIG_HZ_250=y

#
# General Setup
#
CONFIG_LOCALVERSION="-amlogic"
CONFIG_DEFAULT_HOSTNAME="meson"
CONFIG_SYSVIPC=y
CONFIG_POSIX_MQUEUE=y
CONFIG_AUDIT=y
CONFIG_NO_HZ_IDLE=y
CONFIG_HIGH_RES_TIMERS=y
CONFIG_BPF_SYSCALL=y
CONFIG_PREEMPT=y
CONFIG_IKCONFIG=y
CONFIG_IKCONFIG_PROC=y
CONFIG_LOG_BUF_SHIFT=18
CONFIG_CGROUPS=y
CONFIG_MEMCG=y
CONFIG_BLK_CGROUP=y
CONFIG_CGROUP_SCHED=y
CONFIG_CGROUP_FREEZER=y
CONFIG_CPUSETS=y
CONFIG_CGROUP_DEVICE=y
CONFIG_CGROUP_CPUACCT=y
CONFIG_NAMESPACES=y
CONFIG_USER_NS=y
CONFIG_BLK_DEV_INITRD=y
CONFIG_KALLSYMS=y
CONFIG_KALLSYMS_ALL=y
CONFIG_BPF_JIT=y

#
# Modules
#
CONFIG_MODULES=y
CONFIG_MODULE_UNLOAD=y
CONFIG_MODULE_FORCE_UNLOAD=y
CONFIG_MODVERSIONS=y

#
# Block Layer
#
CONFIG_BLK_DEV_BSG=y
CONFIG_BLK_DEV_INTEGRITY=y
CONFIG_BLK_DEV_THROTTLING=y
CONFIG_PARTITION_ADVANCED=y
CONFIG_EFI_PARTITION=y

#
# Amlogic Global Configuration
#
CONFIG_AMLOGIC_MODIFY=y
CONFIG_AMLOGIC_KERNEL_VERSION=15606

#
# Amlogic Custom Drivers
#
CONFIG_AMLOGIC_WIRELESS=
CONFIG_AMLOGIC_BT_DEVICE=y
CONFIG_AMLOGIC_WIFI=y
# CONFIG_AMLOGIC_PWM_32K CONFIG_AMLOGIC_PWM_32K
# CONFIG_AMLOGIC_PWM_MESON CONFIG_AMLOGIC_PWM_32K

#
# CPU/Arch Features
#
CONFIG_ARM64_VA_BITS_48=y
CONFIG_ARM64_PA_BITS_48=y
CONFIG_SCHED_MC=y
CONFIG_NUMA=y
CONFIG_COMPAT=y
CONFIG_ARMV8_DEPRECATED=y
CONFIG_SWP_EMULATION=y
CONFIG_CP15_BARRIER_EMULATION=y
CONFIG_SETEND_EMULATION=y
CONFIG_ARM64_VHE=y

#
# Boot Options
#
CONFIG_EFI=y
CONFIG_DMI=y

#
# Power Management
#
CONFIG_SUSPEND=y
CONFIG_PM_SLEEP=y
CONFIG_PM=y
CONFIG_PM_CLK=y
CONFIG_PM_GENERIC_DOMAINS=y
CONFIG_CPU_PM=y
CONFIG_CPU_IDLE=y
CONFIG_ARM_CPUIDLE=y
CONFIG_CPU_FREQ=y
CONFIG_CPU_FREQ_GOV_PERFORMANCE=y
CONFIG_CPU_FREQ_GOV_SCHEDUTIL=y
CONFIG_CPUFREQ_DT=y

#
# Firmware Drivers
#
CONFIG_ARM_SCMI_PROTOCOL=y
CONFIG_ARM_SCMI_POWER_DOMAIN=y
CONFIG_ARM_SCPI_PROTOCOL=y
CONFIG_ARM_SCPI_POWER_DOMAIN=y
CONFIG_MESON_SM=y
CONFIG_ARM_PSCI_FW=y

#
# Device Drivers - Generic
#
CONFIG_DEVTMPFS=y
CONFIG_DEVTMPFS_MOUNT=y
CONFIG_FW_LOADER=y
CONFIG_FW_LOADER_USER_HELPER=y

#
# Bus Devices
#
CONFIG_SIMPLE_PM_BUS=y

#
# MTD & NAND
#
CONFIG_MTD=y
CONFIG_MTD_BLOCK=y
CONFIG_MTD_NAND_CORE=m
CONFIG_MTD_RAW_NAND=m
CONFIG_MTD_NAND_MESON=m
CONFIG_MTD_SPI_NOR=y

#
# Block Devices
#
CONFIG_BLK_DEV_LOOP=y
CONFIG_BLK_DEV_RAM=m
CONFIG_VIRTIO_BLK=y

#
# SCSI & ATA
#
CONFIG_SCSI=y
CONFIG_BLK_DEV_SD=y
CONFIG_CHR_DEV_SG=m
CONFIG_ATA=m
CONFIG_SATA_AHCI_PLATFORM=m

#
# MD/DM
#
CONFIG_MD=y
CONFIG_BLK_DEV_DM=m
CONFIG_DM_CRYPT=m
CONFIG_DM_VERITY=m

#
# Networking
#
CONFIG_NET=y
CONFIG_PACKET=y
CONFIG_UNIX=y
CONFIG_INET=y
CONFIG_IP_MULTICAST=y
CONFIG_IP_PNP=y
CONFIG_IP_PNP_DHCP=y
CONFIG_IPV6=y
CONFIG_NETFILTER=y
CONFIG_BRIDGE=m

#
# Wireless & Bluetooth
#
CONFIG_WIRELESS=y
CONFIG_WIRELESS_EXT=y
CONFIG_WEXT_CORE=y
CONFIG_WEXT_PROC=y
CONFIG_WEXT_SPY=y
CONFIG_WEXT_PRIV=y
CONFIG_CFG80211=y
CONFIG_CFG80211_WEXT=y
CONFIG_MAC80211=y
CONFIG_BT=m
CONFIG_BT_RFCOMM=m
CONFIG_BT_HIDP=m
CONFIG_BT_HCIBTUSB=m
CONFIG_BT_HCIUART=m
CONFIG_RFKILL=y
CONFIG_RFKILL_INPUT=y

#
# Ethernet
#
CONFIG_NETDEVICES=y
CONFIG_PHYLIB=y
CONFIG_MESON_GXL_PHY=m
CONFIG_STMMAC_ETH=y
CONFIG_STMMAC_PLATFORM=y
CONFIG_DWMAC_GENERIC=m
CONFIG_DWMAC_MESON=m
CONFIG_MDIO_BUS_MUX=y
CONFIG_MDIO_BUS_MUX_MESON_G12A=y

#
# Input Devices
#
CONFIG_INPUT=y
CONFIG_INPUT_EVDEV=y
CONFIG_KEYBOARD_GPIO=y

#
# Serial & TTY
#
CONFIG_TTY=y
CONFIG_SERIAL_8250=y
CONFIG_SERIAL_8250_CONSOLE=y
CONFIG_SERIAL_MESON=y
CONFIG_SERIAL_MESON_CONSOLE=y

#
# I2C
#
CONFIG_I2C=y
CONFIG_I2C_CHARDEV=y
CONFIG_I2C_MUX=m
CONFIG_I2C_MESON=y

#
# SPI
#
CONFIG_SPI=y
CONFIG_SPI_MESON_SPICC=y
CONFIG_SPI_MESON_SPIFC=y

#
# Pinctrl & GPIO
#
CONFIG_PINCTRL=y
CONFIG_GPIOLIB=y
CONFIG_GPIO_SYSFS=y

#
# PWM
#
CONFIG_PWM=y
CONFIG_PWM_SYSFS=y
# CONFIG_PWM_MESON is not set

#
# Watchdog
#
CONFIG_WATCHDOG=y
CONFIG_WATCHDOG_CORE=y

#
# Thermal
#
CONFIG_THERMAL=y
CONFIG_THERMAL_HWMON=y
CONFIG_CPU_THERMAL=y
CONFIG_DEVFREQ_THERMAL=y
CONFIG_THERMAL_EMULATION=y

#
# Multifunction Devices
#
CONFIG_MFD_SYSCON=y

#
# Regulators
#
CONFIG_REGULATOR=y
CONFIG_REGULATOR_FIXED_VOLTAGE=y

#
# Media Support
#
CONFIG_MEDIA_SUPPORT=m
CONFIG_MEDIA_CAMERA_SUPPORT=y
CONFIG_MEDIA_CONTROLLER=y
CONFIG_VIDEO_DEV=m
CONFIG_VIDEO_V4L2=m
CONFIG_V4L_PLATFORM_DRIVERS=y

#
# Remote Control
#
CONFIG_RC_CORE=m
CONFIG_IR_MESON=m

#
# DRM & Graphics
#
CONFIG_DRM=y
CONFIG_DRM_MESON=y
CONFIG_DRM_MESON_DW_HDMI=y
CONFIG_FB=y
CONFIG_FRAMEBUFFER_CONSOLE=y

#
# HID
#
CONFIG_HID=y
CONFIG_UHID=m
CONFIG_HID_GENERIC=y

#
# USB
#
CONFIG_USB_SUPPORT=y
CONFIG_USB=y
CONFIG_USB_ANNOUNCE_NEW_DEVICES=y
CONFIG_USB_XHCI_HCD=y
CONFIG_USB_XHCI_PLATFORM=y
CONFIG_USB_EHCI_HCD=y
CONFIG_USB_EHCI_HCD_PLATFORM=y
CONFIG_USB_OHCI_HCD=y
CONFIG_USB_OHCI_HCD_PLATFORM=y
CONFIG_USB_STORAGE=y
CONFIG_USB_DWC3=y
CONFIG_USB_DWC3_DUAL_ROLE=y
CONFIG_USB_DWC3_MESON_G12A=y
CONFIG_USB_DWC2=y
CONFIG_USB_CHIPIDEA=y
CONFIG_USB_CHIPIDEA_UDC=y
CONFIG_USB_CHIPIDEA_HOST=y
CONFIG_USB_GADGET=y
CONFIG_USB_CONFIGFS=m
CONFIG_USB_CONFIGFS_MASS_STORAGE=y

#
# MMC
#
CONFIG_MMC=y
CONFIG_MMC_BLOCK=y
CONFIG_PWRSEQ_SIMPLE=y
CONFIG_PWRSEQ_EMMC=y
CONFIG_MMC_MESON_GX=y

#
# RTC
#
CONFIG_RTC_CLASS=y

#
# DMA
#
CONFIG_DMADEVICES=y
CONFIG_PL330_DMA=y

#
# SOC specific
#
CONFIG_SOC_BUS=y

#
# Reset
#
CONFIG_RESET_CONTROLLER=y

#
# Clocks
#
CONFIG_COMMON_CLK=y

#
# IOMMU
#
CONFIG_IOMMU_SUPPORT=y
CONFIG_ARM_SMMU=y
CONFIG_ARM_SMMU_V3=y

#
# HWMON
#
CONFIG_HWMON=y

#
# Misc
#
CONFIG_REGMAP=y
CONFIG_REGMAP_MMIO=y
CONFIG_REGMAP_I2C=y
CONFIG_REGMAP_SPI=y

#
# File Systems
#
CONFIG_EXT4_FS=y
CONFIG_EXT4_FS_POSIX_ACL=y
CONFIG_EXT4_FS_SECURITY=y
CONFIG_F2FS_FS=y
CONFIG_VFAT_FS=y
CONFIG_FAT_DEFAULT_UTF8=y
CONFIG_TMPFS=y
CONFIG_TMPFS_POSIX_ACL=y
CONFIG_SQUASHFS=y
CONFIG_SQUASHFS_XATTR=y
CONFIG_SQUASHFS_LZ4=y
CONFIG_SQUASHFS_XZ=y
CONFIG_SQUASHFS_ZSTD=y
CONFIG_OVERLAY_FS=y
CONFIG_NFS_FS=m
CONFIG_NFS_V4=m
CONFIG_ROOT_NFS=y

#
# Security
#
CONFIG_SECURITY=y
CONFIG_SECURITYFS=y
CONFIG_SECURITY_NETWORK=y
CONFIG_SECURITY_SELINUX=y
CONFIG_DEFAULT_SECURITY_SELINUX=y

#
# Crypto
#
CONFIG_CRYPTO_USER=m
CONFIG_CRYPTO_CCM=y
CONFIG_CRYPTO_GCM=y
CONFIG_CRYPTO_CHACHA20POLY1305=y
CONFIG_CRYPTO_ECHAINIV=m
CONFIG_CRYPTO_CBC=y
CONFIG_CRYPTO_CTS=y
CONFIG_CRYPTO_XTS=y
CONFIG_CRYPTO_CMAC=y
CONFIG_CRYPTO_HMAC=y
CONFIG_CRYPTO_XCBC=m
CONFIG_CRYPTO_SHA256=y
CONFIG_CRYPTO_SHA512=y
CONFIG_CRYPTO_AES=y
CONFIG_CRYPTO_DEFLATE=y
CONFIG_CRYPTO_LZO=y
CONFIG_CRYPTO_LZ4=m
CONFIG_CRYPTO_ZSTD=y
CONFIG_CRYPTO_ANSI_CPRNG=m

#
# Kernel Hacking
#
CONFIG_MAGIC_SYSRQ=y
CONFIG_DEBUG_FS=y
CONFIG_DEBUG_KERNEL=y
CONFIG_DEBUG_MISC=y
CONFIG_FRAME_POINTER=y
CONFIG_PRINTK_TIME=y
CONFIG_DYNAMIC_DEBUG=y
CONFIG_DEBUG_BUGVERBOSE=y
```

## drivers/amlogic/Kconfig
```kconfig
# SPDX-License-Identifier: (GPL-2.0+ OR MIT)

config AMLOGIC_GKI
	bool "Amlogic GKI macro"
	default n
	help
		This macro controls GKI module build behavior, if enabled
		some internal code will be build as external module
		
config AMLOGIC_MODIFY
	bool "Amlogic modify for kernel code"
	default n
	help
	  This option is set up for Amlogic modifications of standard
	  kernel source code. All Amlogic-specific changes to common
	  kernel code should be wrapped by this config.

config AMLOGIC_KERNEL_VERSION
	int "Amlogic Kernel Version"
	default 15606
	help
	  Kernel from android15-6.6 is 15606. Drivers may use this
	  number to adapt to different kernel versions.

config AMLOGIC_ARMV8_AARCH64
	bool "AARCH64 kernel support for Amlogic ARMv8 Soc"
	depends on AMLOGIC_MODIFY || COMPILE_TEST
	default y
	help
	  aarch32 and aarch64 kernels are supported for armv8 socs.
	  enable this config to select 64 bit kernel.
	  Select Y if doult.

config AMLOGIC_DRIVER
	bool "Amlogic Peripheral drivers"
	depends on AMLOGIC_MODIFY
	default y
	help
		this option is provided for control amlogic
		drivers, if you want to use amlogic driver
		please open it.
		Note: All amlogic driver should be placed in
		this directory

config AMLOGIC_MEDIA_V4L_DEC
	bool "enable amlogic v4l decode module."
	default n
	help
		Support v4L protocol based decoding components.
		Decoding is done by AmLogic hardware, and if you
		need to support this feature, you need to enable
		this configuration item.

if AMLOGIC_DRIVER
menu "Amlogic Device Drivers"

source "drivers/amlogic/bluetooth/Kconfig"
source "drivers/amlogic/wifi/Kconfig"

endmenu
endif
```

## drivers/amlogic/bluetooth/Kconfig
```kconfig
# SPDX-License-Identifier: (GPL-2.0+ OR MIT)

config AMLOGIC_BT_DEVICE
	bool "BT Device support"
	depends on BT && RFKILL
	default n
	help
	  Say Y here if you want to use the BT device.
```

## drivers/bluetooth/aml_bt/Kconfig
```kconfig
config AMLOGIC_BT_W1
	tristate "Amlogic W1 Bluetooth support"
	depends on BT && AMLOGIC_WIFI_W1
	help
	  This is the driver for Amlogic W1 Bluetooth chipset.
	  
	  The driver requires the W1 WiFi driver (aml_sdio.ko) to be loaded first,
	  as it depends on the shared SDIO interface layer.
	  
	  If you choose to build it as a module, it will be called
	  sdio_bt. If unsure, say N.
```

## drivers/net/wireless/w1/Kconfig
```kconfig
config AMLOGIC_WIFI_W1
	tristate "Amlogic W1 WiFi support"
	depends on CFG80211 && MAC80211
	depends on MMC
	select WIRELESS_EXT
	select WEXT_PRIV
	help
	  This is the driver for Amlogic W1 WiFi chipset.
	  
	  The driver supports SDIO interface.
	  
	  If you choose to build it as a module, it will be called
	  vlsicomm. If unsure, say N.
```
